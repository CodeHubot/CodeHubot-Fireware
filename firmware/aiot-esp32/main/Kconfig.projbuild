## firmware/aiot-esp32/main/Kconfig.projbuild
```kconfig
menu "AIOT Device Configuration"

    menu "Board Selection"
        choice AIOT_BOARD_TYPE
            prompt "Select Board Type"
            default AIOT_BOARD_ESP32_S3_DEVKIT
            help
                Select the board type for this firmware build.
                Different boards have different sensor and GPIO configurations.

            config AIOT_BOARD_ESP32_S3_DEVKIT
                bool "ESP32-S3 DevKit (Standard)"
                help
                    Standard ESP32-S3 DevKit board.
                    Sensors: DHT11 (GPIO35), DS18B20 (GPIO39)
                    Product Code: ESP32-S3-Dev-01

            config AIOT_BOARD_ESP32_S3_DEVKIT_RAIN
                bool "ESP32-S3 DevKit Rain"
                help
                    ESP32-S3 DevKit Rain board with rain sensor.
                    Sensors: DHT11 (GPIO35), Rain Sensor (GPIO39)
                    Product Code: ESP32-S3-Rain-01

            config AIOT_BOARD_ESP32_S3_DEVKIT_LITE
                bool "ESP32-S3 DevKit Lite"
                help
                    ESP32-S3 DevKit Lite board (精简版).
                    Sensors: DHT11 (GPIO35)
                    Product Code: ESP32-S3-Lite-01
        endchoice

        config AIOT_BOARD_NAME
            string
            default "ESP32-S3-DevKit" if AIOT_BOARD_ESP32_S3_DEVKIT
            default "ESP32-S3-DevKit-Rain" if AIOT_BOARD_ESP32_S3_DEVKIT_RAIN
            default "ESP32-S3-DevKit-Lite" if AIOT_BOARD_ESP32_S3_DEVKIT_LITE

        config AIOT_PRODUCT_CODE
            string
            default "ESP32-S3-Dev-01" if AIOT_BOARD_ESP32_S3_DEVKIT
            default "ESP32-S3-Rain-01" if AIOT_BOARD_ESP32_S3_DEVKIT_RAIN
            default "ESP32-S3-Lite-01" if AIOT_BOARD_ESP32_S3_DEVKIT_LITE
    endmenu

    config AIOT_DEVICE_ID
        string "Device ID"
        default "AIOT-ESP32-001"
        help
            Unique identifier for this AIOT device.
            This ID will be used for device registration and identification.

    config AIOT_DEVICE_TYPE
        string "Device Type"
        default "ESP32-S3-DevKit"
        help
            Type of the AIOT device.
            This helps identify the hardware capabilities and configuration.

    config AIOT_FIRMWARE_VERSION
        string "Firmware Version"
        default "1.0.0"
        help
            Current firmware version.
            This version will be reported to the server and used for OTA updates.

    config AIOT_PRODUCT_ID
        string "Product ID"
        default "TEMP_HUMI_SENSOR"
        help
            Product ID for this device. This should match the product code in the backend.
            This ID will be used for device registration and LCD display.
            You can set different product IDs for different boards before flashing.

    config AIOT_DEBUG_LEVEL
        int "Debug Level"
        default 3
        range 0 5
        help
            Debug output level:
            0 = No debug output
            1 = Error messages only
            2 = Error and warning messages
            3 = Error, warning, and info messages
            4 = Error, warning, info, and debug messages
            5 = All messages including verbose debug

    config AIOT_TASK_STACK_SIZE
        int "Default Task Stack Size"
        default 4096
        range 2048 8192
        help
            Default stack size for AIOT tasks in bytes.

    config AIOT_TASK_PRIORITY
        int "Default Task Priority"
        default 5
        range 1 25
        help
            Default priority for AIOT tasks.

    config AIOT_MAX_RETRY_COUNT
        int "Maximum Retry Count"
        default 3
        range 1 10
        help
            Maximum number of retry attempts for network operations.

    config AIOT_HEARTBEAT_INTERVAL_SEC
        int "Heartbeat Interval (seconds)"
        default 30
        range 10 300
        help
            Interval for sending heartbeat messages to the server.

    config AIOT_CONFIG_RESET_GPIO
        int "Configuration Reset GPIO"
        default 0
        range -1 48
        help
            GPIO pin for configuration reset button.
            Set to -1 to disable this feature.

    config AIOT_STATUS_LED_GPIO
        int "Status LED GPIO"
        default 2
        range -1 48
        help
            GPIO pin for status LED.
            Set to -1 to disable this feature.

    config AIOT_ENABLE_WATCHDOG
        bool "Enable Watchdog Timer"
        default y
        help
            Enable watchdog timer for system stability.

    config AIOT_WATCHDOG_TIMEOUT_SEC
        int "Watchdog Timeout (seconds)"
        default 60
        range 10 300
        depends on AIOT_ENABLE_WATCHDOG
        help
            Watchdog timeout in seconds.

endmenu
```

## firmware/aiot-esp32/main/bluetooth/Kconfig
```kconfig
menu "Bluetooth Provisioning Configuration"

    config BT_PROVISION_ENABLED
        bool "Enable Bluetooth Provisioning"
        default y
        depends on BT_ENABLED && BLUEDROID_ENABLED
        help
            Enable Bluetooth provisioning functionality for WiFi and server configuration.
            This allows devices to be configured via Bluetooth Low Energy (BLE).

    config BT_PROVISION_DEVICE_NAME
        string "Bluetooth Device Name"
        default "AIOT-Device"
        depends on BT_PROVISION_ENABLED
        help
            The name that will be advertised when the device is in provisioning mode.
            This name will be visible to users when scanning for devices.

    config BT_PROVISION_SECURITY_ENABLED
        bool "Enable Provisioning Security"
        default y
        depends on BT_PROVISION_ENABLED
        help
            Enable security features for Bluetooth provisioning including
            authentication and encryption of provisioning data.

    config BT_PROVISION_SECURITY_KEY
        string "Provisioning Security Key"
        default "AIOT2024"
        depends on BT_PROVISION_SECURITY_ENABLED
        help
            The security key used for provisioning authentication.
            This should be changed for production deployments.

    config BT_PROVISION_TIMEOUT_MS
        int "Provisioning Timeout (milliseconds)"
        default 300000
        range 30000 600000
        depends on BT_PROVISION_ENABLED
        help
            Timeout for the provisioning process in milliseconds.
            After this timeout, the device will stop advertising and
            return to normal operation mode.

    config BT_PROVISION_RETRY_COUNT
        int "WiFi Connection Retry Count"
        default 3
        range 1 10
        depends on BT_PROVISION_ENABLED
        help
            Number of times to retry WiFi connection during provisioning
            before reporting failure.

    config BT_PROVISION_RETRY_DELAY_MS
        int "Retry Delay (milliseconds)"
        default 5000
        range 1000 30000
        depends on BT_PROVISION_ENABLED
        help
            Delay between WiFi connection retry attempts in milliseconds.

    config BT_PROVISION_AUTO_START
        bool "Auto Start Provisioning"
        default y
        depends on BT_PROVISION_ENABLED
        help
            Automatically start provisioning mode if the device is not
            configured when the system boots up.

    config BT_PROVISION_FORCE_PROVISION_GPIO
        int "Force Provisioning GPIO Pin"
        default -1
        range -1 39
        depends on BT_PROVISION_ENABLED
        help
            GPIO pin number that can be used to force provisioning mode.
            Set to -1 to disable this feature.
            When this pin is pulled low during boot, the device will
            enter provisioning mode regardless of current configuration.

    config BT_PROVISION_STATUS_LED_GPIO
        int "Status LED GPIO Pin"
        default -1
        range -1 39
        depends on BT_PROVISION_ENABLED
        help
            GPIO pin number for status LED indication during provisioning.
            Set to -1 to disable LED status indication.
            The LED will blink to indicate provisioning status.

    config BT_PROVISION_NVS_NAMESPACE
        string "NVS Namespace"
        default "bt_provision"
        depends on BT_PROVISION_ENABLED
        help
            NVS namespace used to store provisioning configuration data.
            This should be unique to avoid conflicts with other components.

    config BT_PROVISION_LOG_LEVEL
        int "Log Level"
        default 3
        range 0 5
        depends on BT_PROVISION_ENABLED
        help
            Log level for Bluetooth provisioning module:
            0 = None, 1 = Error, 2 = Warning, 3 = Info, 4 = Debug, 5 = Verbose

    config BT_PROVISION_GATT_MTU_SIZE
        int "GATT MTU Size"
        default 512
        range 23 512
        depends on BT_PROVISION_ENABLED
        help
            Maximum Transmission Unit (MTU) size for GATT characteristics.
            Larger values allow for more data to be sent in a single packet
            but may not be supported by all clients.

    config BT_PROVISION_MAX_CONNECTIONS
        int "Maximum BLE Connections"
        default 1
        range 1 4
        depends on BT_PROVISION_ENABLED
        help
            Maximum number of simultaneous BLE connections during provisioning.
            Usually 1 is sufficient for most use cases.

endmenu
```
