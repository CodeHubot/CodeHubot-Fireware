## firmware/aiot-esp32/main/wechat_ble/Kconfig
```kconfig
menu "WeChat BLE Configuration"

    config WECHAT_BLE_ENABLE
        bool "Enable WeChat BLE functionality"
        default y
        help
            Enable WeChat Mini Program Bluetooth functionality for device configuration.

    config WECHAT_BLE_DEVICE_NAME
        string "BLE Device Name"
        default "AIOT-Device"
        depends on WECHAT_BLE_ENABLE
        help
            The name that will be advertised by the BLE device.

    config WECHAT_BLE_SERVICE_UUID
        string "BLE Service UUID"
        default "12345678-1234-1234-1234-123456789abc"
        depends on WECHAT_BLE_ENABLE
        help
            The UUID of the main BLE service.

    config WECHAT_BLE_CHAR_READ_UUID
        string "BLE Read Characteristic UUID"
        default "87654321-4321-4321-4321-cba987654321"
        depends on WECHAT_BLE_ENABLE
        help
            The UUID of the read characteristic.

    config WECHAT_BLE_CHAR_WRITE_UUID
        string "BLE Write Characteristic UUID"
        default "11111111-2222-3333-4444-555555555555"
        depends on WECHAT_BLE_ENABLE
        help
            The UUID of the write characteristic.

    config WECHAT_BLE_MAX_DATA_LEN
        int "Maximum data length"
        default 512
        range 20 1024
        depends on WECHAT_BLE_ENABLE
        help
            Maximum length of data that can be sent/received in a single BLE packet.

    config WECHAT_BLE_SECURITY_ENABLE
        bool "Enable BLE Security"
        default n
        depends on WECHAT_BLE_ENABLE
        help
            Enable BLE security features like pairing and encryption.

    config WECHAT_BLE_PASSKEY
        int "BLE Passkey"
        default 123456
        range 0 999999
        depends on WECHAT_BLE_SECURITY_ENABLE
        help
            The passkey used for BLE pairing (6 digits).

    config WECHAT_BLE_AUTO_DISCONNECT_TIMEOUT
        int "Auto disconnect timeout (seconds)"
        default 300
        range 60 3600
        depends on WECHAT_BLE_ENABLE
        help
            Automatically disconnect BLE connection after this timeout (in seconds).

    config WECHAT_BLE_DEBUG_ENABLE
        bool "Enable debug output"
        default n
        depends on WECHAT_BLE_ENABLE
        help
            Enable debug output for WeChat BLE module.

    config WECHAT_BLE_TASK_STACK_SIZE
        int "Task stack size"
        default 4096
        range 2048 8192
        depends on WECHAT_BLE_ENABLE
        help
            Stack size for WeChat BLE task.

    config WECHAT_BLE_TASK_PRIORITY
        int "Task priority"
        default 5
        range 1 25
        depends on WECHAT_BLE_ENABLE
        help
            Priority for WeChat BLE task.

endmenu
```

## firmware/aiot-esp32/sdkconfig.defaults
```kconfig
# ESP32-S3 DevKit Configuration
# This file contains default configuration for ESP32-S3 based AIOT project

# Target Configuration
CONFIG_IDF_TARGET="esp32s3"

# Serial flasher config
CONFIG_ESPTOOLPY_FLASHMODE_QIO=y
CONFIG_ESPTOOLPY_FLASHSIZE_16MB=y
CONFIG_ESPTOOLPY_FLASHFREQ_80M=y

# Partition Table
CONFIG_PARTITION_TABLE_CUSTOM=y
CONFIG_PARTITION_TABLE_CUSTOM_FILENAME="partitions.csv"

# Component config

# ESP32S3-Specific Configuration
CONFIG_ESP32S3_DEFAULT_CPU_FREQ_240=y

# PSRAM配置 - 明确禁用以避免内存测试失败
CONFIG_SPIRAM=n
CONFIG_ESP32S3_SPIRAM_SUPPORT=n

# FreeRTOS
CONFIG_FREERTOS_HZ=1000

# Log output
CONFIG_LOG_DEFAULT_LEVEL_INFO=y
CONFIG_LOG_MAXIMUM_LEVEL_VERBOSE=y

# WiFi Configuration
CONFIG_ESP32_WIFI_STATIC_RX_BUFFER_NUM=10
CONFIG_ESP32_WIFI_DYNAMIC_RX_BUFFER_NUM=32
CONFIG_ESP32_WIFI_STATIC_TX_BUFFER_NUM=0
CONFIG_ESP32_WIFI_DYNAMIC_TX_BUFFER_NUM=32

# LWIP
CONFIG_LWIP_TCP_SND_BUF_DEFAULT=65535
CONFIG_LWIP_TCP_WND_DEFAULT=65535
CONFIG_LWIP_TCP_RECVMBOX_SIZE=32
CONFIG_LWIP_UDP_RECVMBOX_SIZE=32
CONFIG_LWIP_TCPIP_RECVMBOX_SIZE=32

# MQTT
CONFIG_MQTT_PROTOCOL_311=y
CONFIG_MQTT_TRANSPORT_SSL=y
CONFIG_MQTT_TRANSPORT_WEBSOCKET=y

# GPIO Configuration
CONFIG_GPIO_ESP32_SUPPORT_SWITCH_SLP_PULL=y

# PWM/LEDC Configuration
CONFIG_SOC_LEDC_SUPPORT_FADE_STOP=y

# HTTP Server Configuration - 解决配网页面 "Header fields are too long" 问题
# 某些手机应用（华为、小红书等）会发送超大的HTTP请求头
CONFIG_HTTPD_MAX_REQ_HDR_LEN=2048
CONFIG_HTTPD_MAX_URI_LEN=1024

# Application Configuration - Board Selection
# 板子选择：取消注释其中一个，注释掉其他的
# CONFIG_AIOT_BOARD_ESP32_S3_DEVKIT=y
# CONFIG_AIOT_BOARD_ESP32_S3_DEVKIT_RAIN=y
CONFIG_AIOT_BOARD_ESP32_S3_DEVKIT_LITE=y

# 板子配置会自动设置以下值：
# - CONFIG_AIOT_BOARD_NAME
# - CONFIG_AIOT_PRODUCT_CODE

# Legacy Configuration (保留兼容性)
CONFIG_AIOT_LED_COUNT=2
CONFIG_AIOT_RELAY_COUNT=2
CONFIG_AIOT_SERVO_COUNT=2
CONFIG_AIOT_SENSOR_COUNT=2

# Main Task Stack Size (增加栈大小以支持更多调试日志和局部变量)
CONFIG_ESP_MAIN_TASK_STACK_SIZE=12288

# System Event Task Stack Size (增加栈大小以避免在事件处理器中栈溢出)
CONFIG_ESP_SYSTEM_EVENT_TASK_STACK_SIZE=4096
```

## firmware/aiot-esp32c3-lite/sdkconfig.defaults
```kconfig
# ESP32-C3 精简版固件 - 默认配置
# 4MB Flash, 无OTA, 无LVGL, 优化固件大小

# ==================== 目标芯片配置 ====================
CONFIG_IDF_TARGET="esp32c3"

# ==================== Flash配置 ====================
CONFIG_ESPTOOLPY_FLASHMODE_DIO=y
CONFIG_ESPTOOLPY_FLASHSIZE_4MB=y
CONFIG_ESPTOOLPY_FLASHFREQ_40M=y

# ==================== 分区表配置 ====================
CONFIG_PARTITION_TABLE_CUSTOM=y
CONFIG_PARTITION_TABLE_CUSTOM_FILENAME="partitions.csv"
CONFIG_PARTITION_TABLE_OFFSET=0x8000

# ==================== ESP32C3芯片配置 ====================
CONFIG_ESP32C3_DEFAULT_CPU_FREQ_160=y
CONFIG_ESP32C3_REV_MIN_3=y

# ==================== 编译优化 - 优化固件大小 ====================
CONFIG_COMPILER_OPTIMIZATION_SIZE=y
CONFIG_COMPILER_OPTIMIZATION_ASSERTIONS_DISABLE=y
CONFIG_COMPILER_OPTIMIZATION_ASSERTION_LEVEL=0

# ==================== FreeRTOS配置 ====================
CONFIG_FREERTOS_HZ=100
CONFIG_FREERTOS_UNICORE=y
CONFIG_FREERTOS_USE_TRACE_FACILITY=n
CONFIG_FREERTOS_USE_STATS_FORMATTING_FUNCTIONS=n

# ==================== 日志配置 ====================
CONFIG_LOG_DEFAULT_LEVEL_INFO=y
CONFIG_LOG_MAXIMUM_LEVEL_VERBOSE=y
CONFIG_LOG_COLORS=y

# ==================== WiFi配置 ====================
CONFIG_ESP_WIFI_STATIC_RX_BUFFER_NUM=4
CONFIG_ESP_WIFI_DYNAMIC_RX_BUFFER_NUM=8
CONFIG_ESP_WIFI_STATIC_TX_BUFFER_NUM=0
CONFIG_ESP_WIFI_DYNAMIC_TX_BUFFER_NUM=8
CONFIG_ESP_WIFI_AMPDU_TX_ENABLED=n
CONFIG_ESP_WIFI_AMPDU_RX_ENABLED=n
CONFIG_ESP_WIFI_AMSDU_TX_ENABLED=n

# WiFi省电模式
CONFIG_ESP_WIFI_SLP_IRAM_OPT=n

# ==================== LWIP配置 - 精简 ====================
CONFIG_LWIP_TCP_SND_BUF_DEFAULT=5760
CONFIG_LWIP_TCP_WND_DEFAULT=5760
CONFIG_LWIP_TCP_RECVMBOX_SIZE=6
CONFIG_LWIP_UDP_RECVMBOX_SIZE=6
CONFIG_LWIP_TCPIP_RECVMBOX_SIZE=8
CONFIG_LWIP_IPV6=n
CONFIG_LWIP_IPV4=y

# ==================== MQTT配置 ====================
CONFIG_MQTT_PROTOCOL_311=y
CONFIG_MQTT_TRANSPORT_SSL=n
CONFIG_MQTT_TRANSPORT_WEBSOCKET=n

# ==================== 蓝牙配置 - 可选禁用以节省空间 ====================
# 如果不需要蓝牙，取消注释以下行以节省约150KB
# CONFIG_BT_ENABLED=n

# ==================== HTTP Server配置 ====================
CONFIG_HTTPD_MAX_REQ_HDR_LEN=1024
CONFIG_HTTPD_MAX_URI_LEN=512

# ==================== 禁用不需要的功能 - 节省空间 ====================
# 禁用PSRAM (ESP32-C3没有PSRAM)
CONFIG_SPIRAM=n

# 禁用以太网
CONFIG_ETH_ENABLED=n

# 禁用mDNS (如果不需要)
# CONFIG_MDNS_SERVICE_ADD_TIMEOUT_MS=2000

# 禁用不需要的协议
CONFIG_LWIP_IGMP=n
CONFIG_LWIP_MULTICAST_PING=n

# ==================== GPIO配置 ====================
CONFIG_GPIO_ESP32_SUPPORT_SWITCH_SLP_PULL=y

# ==================== 主任务配置 ====================
CONFIG_ESP_MAIN_TASK_STACK_SIZE=8192
CONFIG_ESP_SYSTEM_EVENT_TASK_STACK_SIZE=3072
CONFIG_ESP_TIMER_TASK_STACK_SIZE=3072

# ==================== 看门狗配置 ====================
CONFIG_ESP_TASK_WDT_TIMEOUT_S=30
CONFIG_ESP_TASK_WDT_CHECK_IDLE_TASK_CPU0=y

# ==================== 电源管理 ====================
CONFIG_PM_ENABLE=y

# ==================== Bootloader配置 ====================
CONFIG_BOOTLOADER_LOG_LEVEL_INFO=y
CONFIG_BOOTLOADER_SKIP_VALIDATE_IN_DEEP_SLEEP=y

# ==================== NVS配置 ====================
CONFIG_NVS_ENCRYPTION=n

# ==================== 应用配置 ====================
# 产品代码
CONFIG_AIOT_PRODUCT_CODE="ESP32-C3-Lite-01"

# 设备特性
CONFIG_AIOT_LED_COUNT=1
CONFIG_AIOT_RELAY_COUNT=1
CONFIG_AIOT_SERVO_COUNT=0
CONFIG_AIOT_SENSOR_COUNT=1

# 功能开关
CONFIG_AIOT_SUPPORT_OTA=n
CONFIG_AIOT_SUPPORT_DISPLAY=n
CONFIG_AIOT_SUPPORT_LVGL=n
CONFIG_AIOT_SUPPORT_SERVO=n
CONFIG_AIOT_SUPPORT_PWM_ADVANCED=n

# ==================== 调试配置 ====================
# 发布版本建议禁用以下调试功能
# CONFIG_ESP_SYSTEM_PANIC_PRINT_REBOOT=y
# CONFIG_ESP_COREDUMP_ENABLE=n
```
